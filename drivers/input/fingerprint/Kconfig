## drivers/input/fingerprint/Kconfig
```kconfig
menuconfig INPUT_FINGERPRINT
	bool "Fingerprint support"
	depends on INPUT
	default y
	help
	  Microarray SPI fingerprint (factory-spec port, r39).

if INPUT_FINGERPRINT
config MICROARRAY_FINGERPRINT
	bool "Microarray mas fingerprint (W527)"
	default y
endif
```

## drivers/input/misc/mir3da/Kconfig
```kconfig
config SENSORS_MIR3DA
	bool "mir3da/da21x gsensor (W527)"
	depends on I2C
	default y
	help
	  MiraSensor gsensor for W527 (legacy i2c board info registration).
```

## drivers/input/misc/qmc6308/Kconfig
```kconfig
config SENSORS_QMC6308
	bool "QMC6308 magnetic sensor (W527)"
	depends on I2C
	default y
	help
	  QMC6308 compass for W527 (compatible "qmc,qmc6308").
```

## drivers/misc/bd1860/Kconfig
```kconfig
config BD1860
	bool "BD1860 heart-rate sensor driver + decompiled health algorithm (W527)"
	depends on I2C
	default y
	help
	  BD1860 HR sensor: factory-transaction driver (r43 pipeline) with
	  r44 decompiled health algorithm cluster (FFT/IIR/HR/HRV/SPO2/BP).
	  Debug prints are gated behind module param `dbg` (default OFF, r51/r52).
```
